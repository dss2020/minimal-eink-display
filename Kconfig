## Kconfig
```kconfig
# SPDX-License-Identifier: Apache-2.0

menu "Minimal e-ink display"

rsource "drivers/Kconfig"
rsource "lib/Kconfig"

endmenu
```

## boards/shields/xiao_despi_c579/Kconfig.defconfig
```kconfig
# SPDX-License-Identifier: Apache-2.0

if SHIELD_XIAO_DESPI_C579_GDEY0579F51 || SHIELD_XIAO_DESPI_C579_GDEY0579F52

config IMAGE_PACK_WIDTH
	default 792

config IMAGE_PACK_HEIGHT
	default 272

choice IMAGE_PACK_FORMAT
	default IMAGE_PACK_FORMAT_BWYR
endchoice

endif
```

## boards/shields/xiao_despi_c579/Kconfig.shield
```kconfig
# SPDX-License-Identifier: Apache-2.0

config SHIELD_XIAO_DESPI_C579_GDEY0579F51
	def_bool $(shields_list_contains,xiao_despi_c579_gdey0579f51)

config SHIELD_XIAO_DESPI_C579_GDEY0579F52
	def_bool $(shields_list_contains,xiao_despi_c579_gdey0579f52)
```

## boards/shields/xiao_epaper_4in2_v2/Kconfig.shield
```kconfig
# SPDX-License-Identifier: Apache-2.0

config SHIELD_XIAO_EPAPER_4IN2_V2
	def_bool $(shields_list_contains,xiao_epaper_4in2_v2)
```

## drivers/Kconfig
```kconfig
# SPDX-License-Identifier: Apache-2.0

if DISPLAY

rsource "display/Kconfig"

endif # DISPLAY
```

## drivers/display/Kconfig
```kconfig
# SPDX-License-Identifier: Apache-2.0

config GDEY0579F5X
	bool "Good Display GDEY0579F51/F52 four-colour e-paper panels"
	default y
	depends on DT_HAS_GOODDISPLAY_GDEY0579F51_ENABLED || DT_HAS_GOODDISPLAY_GDEY0579F52_ENABLED
	select MIPI_DBI
	select DISPLAY_COLOR_PALETTE
	help
	  Driver for the 5.79 inch 792x272 black/white/yellow/red panels, which
	  have two cascaded controllers behind one chip select. The driver keeps
	  a frame buffer of 2 bits per pixel in RAM.
```

## dts/bindings/display/gooddisplay,gdey0579f51.yaml
```yaml
# SPDX-License-Identifier: Apache-2.0

description: |
  Good Display GDEY0579F51, 5.79 inch 792x272 black/white/yellow/red e-paper
  panel with two cascaded controllers.

compatible: "gooddisplay,gdey0579f51"

include: gooddisplay,gdey0579f5x-common.yaml
```

## dts/bindings/display/gooddisplay,gdey0579f52.yaml
```yaml
# SPDX-License-Identifier: Apache-2.0

description: |
  Good Display GDEY0579F52, 5.79 inch 792x272 black/white/yellow/red e-paper
  panel with two cascaded controllers.

compatible: "gooddisplay,gdey0579f52"

include: gooddisplay,gdey0579f5x-common.yaml

properties:
  fast-refresh:
    type: boolean
    description: |
      Use the panel's fast refresh waveform (about 12 s) instead of the
      full one (about 20 s).
```

## dts/bindings/display/gooddisplay,gdey0579f5x-common.yaml
```yaml
# SPDX-License-Identifier: Apache-2.0

include: [mipi-dbi-spi-device.yaml, display-controller.yaml]

properties:
  busy-gpios:
    type: phandle-array
    required: true
    description: |
      BUSY pin. The panel drives it low while busy, so it is normally
      GPIO_ACTIVE_LOW.

  width:
    default: 792

  height:
    default: 272
```

## dts/bindings/power/timed-poweroff-hold.yaml
```yaml
# SPDX-License-Identifier: Apache-2.0

description: |
  Pins that timed_poweroff() drives to their inactive level and keeps there
  while the system is powered off, so that devices wired to them do not see
  floating inputs. The pins are released again at the next boot.

  Give each pin the same active level as its normal use: an active-low chip
  select or reset line is then held high.

compatible: "timed-poweroff-hold"

properties:
  gpios:
    type: phandle-array
    required: true
```

## lib/Kconfig
```kconfig
# SPDX-License-Identifier: Apache-2.0

rsource "image_pack/Kconfig"
rsource "timed_poweroff/Kconfig"
```

## lib/image_pack/Kconfig
```kconfig
# SPDX-License-Identifier: Apache-2.0

menuconfig IMAGE_PACK
	bool "Embedded e-ink image pack"
	help
	  Convert the pictures in IMAGE_PACK_SOURCE_DIR at build time into a compact
	  image pack of IMAGE_PACK_WIDTH x IMAGE_PACK_HEIGHT pixels, link it into the
	  firmware as read-only data and expose it through <eink/image_pack.h>.
	  Requires Python with Pillow on the build host.

if IMAGE_PACK

config IMAGE_PACK_WIDTH
	int "Picture width in pixels"
	default 0
	help
	  Width of the picture as seen by the viewer. Normally set by the
	  display shield or board.

config IMAGE_PACK_HEIGHT
	int "Picture height in pixels"
	default 0
	help
	  Height of the picture as seen by the viewer. Normally set by the
	  display shield or board.

choice IMAGE_PACK_FORMAT
	prompt "Picture colour format"
	default IMAGE_PACK_FORMAT_MONO
	help
	  Colours the pictures are converted to. Normally set by the display
	  shield or board to match the panel.

config IMAGE_PACK_FORMAT_MONO
	bool "Black/white, 1 bit per pixel"

config IMAGE_PACK_FORMAT_BWYR
	bool "Black/white/yellow/red, 2 bits per pixel"
	help
	  Stored as palette indices: 0 black, 1 white, 2 yellow, 3 red.

endchoice # IMAGE_PACK_FORMAT

config IMAGE_PACK_BPP
	int
	default 2 if IMAGE_PACK_FORMAT_BWYR
	default 1

config IMAGE_PACK_SOURCE_DIR
	string "Source picture folder"
	default "pictures"
	help
	  Folder containing the source JPG/PNG files. A relative path is resolved
	  against the repository root (the Zephyr module directory); an absolute
	  path is used as is.

choice IMAGE_PACK_FIT
	prompt "Picture fitting"
	default IMAGE_PACK_FIT_COVER
	help
	  How pictures with a different aspect ratio are fitted to the display.

config IMAGE_PACK_FIT_COVER
	bool "Cover (scale and crop)"
	help
	  Scale the picture to fill the whole display, cropping the overflow.

config IMAGE_PACK_FIT_CONTAIN
	bool "Contain (scale and letterbox)"
	help
	  Scale the picture to fit entirely inside the display, padding the
	  remaining area with white.

endchoice # IMAGE_PACK_FIT

choice IMAGE_PACK_DITHER
	prompt "Dithering"
	default IMAGE_PACK_DITHER_FS
	help
	  How pictures are reduced to 1 bit per pixel.

config IMAGE_PACK_DITHER_FS
	bool "Floyd-Steinberg"
	help
	  Use Floyd-Steinberg error diffusion, which preserves tonal detail.

config IMAGE_PACK_DITHER_NONE
	bool "None (threshold)"
	help
	  Use a plain threshold without dithering.

endchoice # IMAGE_PACK_DITHER

config IMAGE_PACK_ROTATE_180
	bool "Rotate pictures by 180 degrees"
	help
	  Turn every picture upside down, for a panel mounted the other way
	  up (with its connector on the opposite side). Done at build time, so
	  it costs nothing at run time.

module = IMAGE_PACK
module-str = image_pack
source "subsys/logging/Kconfig.template.log_config"

endif # IMAGE_PACK
```

## lib/timed_poweroff/Kconfig
```kconfig
# SPDX-License-Identifier: Apache-2.0

config TIMED_POWEROFF
	bool "Timed power-off"
	depends on HAS_POWEROFF
	depends on SOC_FAMILY_ESPRESSIF_ESP32
	select POWEROFF
	select GPIO
	help
	  Provide timed_poweroff(), which puts the SoC into its lowest power
	  state and restarts it after a given delay. RAM contents are lost
	  apart from retained memory.

	  Only an Espressif ESP32 backend (deep sleep with RTC timer wake-up)
	  exists so far. Add a backend source file and extend the dependency
	  above to support another SoC family.
```
